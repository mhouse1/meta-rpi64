## conf/local.conf.sample
```bitbake
# Local configuration for meta-rpi64 images
# Yocto Project 4.0 Poky distribution [kirkstone] branch
# This is a systemd system

LICENSE_FLAGS_ACCEPTED = "commercial"

DISTRO_FEATURES = "ext2 security systemd usbhost ${DISTRO_FEATURES_LIBC}"

DISTRO_FEATURES_BACKFILL_CONSIDERED += "pulseaudio sysvinit"

DISTRO_FEATURES:remove = "ptest"

INIT_MANAGER = "systemd"

MACHINE_FEATURES:remove = "apm vc4graphics vfat"

# IMAGE_FSTYPES = "tar.xz ext3"
# generate rpi-sdimage for use with imager software such as etcher
# IMAGE_FSTYPES = "rpi-sdimg"

IMAGE_INSTALL:append = " rauc"

IMAGE_FSTYPES="tar.bz2 ext4 wic.bz2 wic.bmap"
SDIMG_ROOTFS_TYPE="ext4"
ENABLE_UART = "1"
RPI_USE_U_BOOT = "1"
PREFERRED_PROVIDER_virtual/bootloader = "u-boot"

WKS_FILE = "sdimage-dual-raspberrypi.wks.in"

MACHINE = "raspberrypi4-64"

KERNEL_IMAGETYPE = "Image"

DISABLE_OVERSCAN = "1"
SERIAL_CONSOLES = "115200;ttyS0"

# PREFERRED_VERSION_linux-raspberrypi = "5.10.%"

#DL_DIR = "/oe/dl/kirkstone"
#SSTATE_DIR = "/oe/rpi64/sstate-cache"
#TMPDIR = "/oe/rpi64/tmp"

DISTRO = "poky"
PACKAGE_CLASSES = "package_ipk"

# i686 or x86_64
SDKMACHINE = "x86_64"

# for no root passwd uncomment the following and comment the two extra user lines
EXTRA_IMAGE_FEATURES = "debug-tweaks"

# does not work in kirkstone anymore since plaintext -P passwords are not supported
# for a root passwd, change mhouseos below to your password
#INHERIT += "extrausers"
#EXTRA_USERS_PARAMS = "usermod -P mhouseos root; "

# this will force root to change password on first login
# INHERIT += "chageusers"
# CHAGE_USERS_PARAMS = "chage -d0 root; "

PATCHRESOLVE = "noop"
RM_OLD_IMAGE = "1"
INHERIT += "rm_work"
CONF_VERSION = "2"

DISABLE_RPI_BOOT_LOGO = "1"

hostname_pn-base-files = "mhouseos"
```
